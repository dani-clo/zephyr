/*
 * Copyright 2026 NXP
 *
 * SPDX-License-Identifier: Apache-2.0
 */

#include <nxp/s32/S32K344_K324_K314_172HDQFP-pinctrl.h>

&pinctrl {
	lpuart2_default: lpuart2_default {
		group1 {
			pinmux = <PTA9_LPUART2_TX_O>;
			output-enable;
		};

		group2 {
			pinmux = <PTA8_LPUART2_RX>;
			input-enable;
		};
	};
};
