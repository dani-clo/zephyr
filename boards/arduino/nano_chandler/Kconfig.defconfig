## boards/arduino/nano_chandler/Kconfig.defconfig
```kconfig
# Copyright (c) 2026 Arduino SA
# SPDX-License-Identifier: Apache-2.0

if BOARD_ARDUINO_NANO_CHANDLER

config USE_DT_CODE_PARTITION
	default y

endif # BOARD_ARDUINO_NANO_CHANDLER
```

## boards/nxp/s32k312_evb/Kconfig.defconfig
```kconfig
# Copyright 2026 NXP
# SPDX-License-Identifier: Apache-2.0

if BOARD_S32K312_EVB

if SERIAL

config UART_CONSOLE
	default y

endif # SERIAL

endif # BOARD_S32K312_EVB
```

## boards/nxp/s32k312_evb/Kconfig.s32k312_evb
```kconfig
# Copyright 2026 NXP
# SPDX-License-Identifier: Apache-2.0

config BOARD_S32K312_EVB
	select SOC_S32K312
	select SOC_PART_NUMBER_PS32K312EHVPBS
```

## boards/nxp/s32k312_evb/board.yml
```yaml
board:
  name: s32k312_evb
  full_name: NXP S32K312EVB-Q172
  vendor: nxp
  socs:
    - name: s32k312
```

## boards/shields/nano_chandler_monica/Kconfig.shield
```kconfig
# Copyright (c) 2026 Arduino SA
# SPDX-License-Identifier: Apache-2.0

config SHIELD_NANO_CHANDLER_MONICA
	def_bool $(shields_list_contains,nano_chandler_monica)
```

## drivers/video/Kconfig.gc2145
```kconfig
# Copyright (c) 2024 Felipe Neves
# SPDX-License-Identifier: Apache-2.0

config VIDEO_GC2145
	bool "GC2145 CMOS digital image sensor"
	select I2C
	depends on DT_HAS_GALAXYCORE_GC2145_ENABLED
	default y
	help
	  Enable driver for GC2145 CMOS digital image sensor device.

config VIDEO_GC2145_DVP_PLL_MULTIPLIER
	int "GC2145 parallel-output PLL multiplier field"
	depends on VIDEO_GC2145
	range 1 63
	default 5
	help
	  DIVX4 field in PLL mode register 0xf8 for the parallel interface.
	  Lower values reduce the sensor pixel clock and frame rate, allowing
	  capture into external memory shared with a display controller.
	  The CSI interface retains its own clock configuration.

config VIDEO_GC2145_DVP_CLOCK_DIV2
	bool "Divide the GC2145 parallel-output clock by two"
	depends on VIDEO_GC2145
	help
	  Enable the digital clock divider in register 0xfa for the parallel
	  interface. This reduces peak DMA traffic without changing XCLK or
	  the PLL input frequency. The CSI configuration is unchanged.
```

## dts/bindings/sdhc/microchip,sdhc-g1.yaml
```yaml
# Copyright (c) 2026 Microchip Technology Inc.
# SPDX-License-Identifier: Apache-2.0

title: Microchip SDHC controller

description: |
  Microchip SDHC controller

  Microchip G1 SDHC controller supports the following hardware peripheral:
    - module name="SDHC" compatible="microchip,sdhc-g1"

compatible: "microchip,sdhc-g1"

include:
  - name: sdhc.yaml
  - name: pinctrl-device.yaml

properties:
  reg:
    required: true

  clocks:
    required: true

  clock-names:
    required: true
    description: |
      Names of the clock sources listed in "clocks", in the same order.
      Must be "mclk" (main clock), "gclk" (generic clock) and "gclk-slow"
      (slow generic clock).

  interrupts:
    required: true

  auto-cmd12:
    type: boolean
    description: |
      Enable Auto CMD12 for multi-block transfers. The host controller
      automatically issues CMD12 (stop transmission) after the last block.
      Use this for cards that do not support CMD23.

  auto-cmd23:
    type: boolean
    description: |
      Enable Auto CMD23 for multi-block transfers. The host controller
      automatically issues CMD23 (set block count) before the transfer.
      Requires ADMA and card CMD23 support (SCR bit 33). Takes precedence
      over auto-cmd12 if both are set.

  pinctrl-0:
    required: true

  pinctrl-names:
    required: true
    description: |
      Names of the pinctrl states defined for this controller. Must include
      "default" matching pinctrl-0.

  bus-width:
    type: int
    enum:
      - 1
      - 4
    default: 4
    description: |
      SD bus width in bits
      By default 4-bit data line is enabled and can be adjusted based on the SDMMC
      instance or hardware board design.

examples:
  - |
    #Example devicetree configuration for Microchip G1 SDHC controller:

    sdhc0: sdhc@46000000 {
            compatible = "microchip,sdhc-g1";
            reg = <0x46000000 0x234>;
            interrupts = <136 0>;
            clocks = <&mclkperiph CLOCK_MCHP_MCLKPERIPH_ID_AHB_SDHC1>,
                     <&gclkperiph CLOCK_MCHP_GCLKPERIPH_ID_SDHC1>,
                     <&gclkperiph CLOCK_MCHP_GCLKPERIPH_ID_SDHC1_SLOW>;
            clock-names = "mclk", "gclk", "gclk-slow";
            min-bus-freq = <400000>;
            max-bus-freq = <50000000>;
            auto-cmd23;
            pinctrl-0 = <&sdhc0_default>;
            pinctrl-names = "default";
            status = "okay";
    };
```

## samples/net/dhcpv4_client/boards/portenta_h7_validation.conf
```kconfig
# SPDX-License-Identifier: Apache-2.0

CONFIG_SERIAL=y
CONFIG_UART_CONSOLE=y
CONFIG_SHELL=y
CONFIG_SHELL_BACKEND_SERIAL=y
CONFIG_SHELL_BACKEND_SERIAL_CHECK_DTR=n
CONFIG_ASSERT=y
CONFIG_ETHERNET_LOG_LEVEL_DBG=y
```

## tests/drivers/pinctrl/microchip/testcase.yaml
```yaml
tests:
  drivers.pinctrl.microchip:
    tags:
      - drivers
      - pinctrl
    platform_allow:
      - sam_e54_xpro
      - pic32ck_gc01_cult
      - pic32ck_sg01_cult
      - pic32cx_sg41_cult
      - pic32cx_sg61_cult
      - pic32cm_jh01_cpro
      - pic32cz_ca80_cult
      - pic32cz_ca90_cult
      - pic32cm_pl10_cnano
```
